## br2-external/Config.in
```kconfig
source "$BR2_EXTERNAL_TAQ102_PATH/package/glcube/Config.in"
source "$BR2_EXTERNAL_TAQ102_PATH/package/mali-utgard/Config.in"
source "$BR2_EXTERNAL_TAQ102_PATH/package/particles/Config.in"
source "$BR2_EXTERNAL_TAQ102_PATH/package/reboot-loader/Config.in"
source "$BR2_EXTERNAL_TAQ102_PATH/package/rescue-screen/Config.in"
source "$BR2_EXTERNAL_TAQ102_PATH/package/taq102-diag/Config.in"
source "$BR2_EXTERNAL_TAQ102_PATH/package/taq102-display/Config.in"
source "$BR2_EXTERNAL_TAQ102_PATH/package/taq102-cube/Config.in"
source "$BR2_EXTERNAL_TAQ102_PATH/package/taq102-fonts/Config.in"
source "$BR2_EXTERNAL_TAQ102_PATH/package/taq102-ssh/Config.in"
source "$BR2_EXTERNAL_TAQ102_PATH/package/taq102-wifi/Config.in"
```

## br2-external/package/dmxdesk/Config.in
```kconfig
config BR2_PACKAGE_DMXDESK
	bool "dmxdesk"
	depends on BR2_USE_MMU
	depends on BR2_TOOLCHAIN_HAS_THREADS
	select BR2_PACKAGE_LIBDRM
	select BR2_PACKAGE_STB
	select BR2_PACKAGE_TAQ102_FONTS
	help
	  Touch lighting desk for the Vibra QLC+ show, with its generated map
	  and a launcher that resolves mainline input devices by name.

	  https://github.com/spectalive/dmxdesk
```

## br2-external/package/glcube/Config.in
```kconfig
config BR2_PACKAGE_GLCUBE
	bool "glcube"
	depends on BR2_PACKAGE_HAS_LIBEGL
	depends on BR2_PACKAGE_HAS_LIBGLES
	depends on BR2_PACKAGE_HAS_LIBGBM
	select BR2_PACKAGE_LIBDRM
	select BR2_PACKAGE_STB
	select BR2_PACKAGE_TAQ102_FONTS
	help
	  A lit, spinning cube rendered by the Mali-400 through EGL/GLES2
	  on a GBM surface and scanned out by KMS page flips, with the
	  touchscreen spinning it. The proof that the GPU works.

comment "glcube needs EGL, GLES and GBM"
	depends on !BR2_PACKAGE_HAS_LIBEGL || !BR2_PACKAGE_HAS_LIBGLES || \
		!BR2_PACKAGE_HAS_LIBGBM
```

## br2-external/package/mali-utgard/Config.in
```kconfig
config BR2_PACKAGE_MALI_UTGARD
	bool "mali-utgard (Mali-400 blob)"
	depends on BR2_ARM_EABIHF
	depends on BR2_TOOLCHAIN_USES_GLIBC
	depends on BR2_TOOLCHAIN_HAS_THREADS
	select BR2_PACKAGE_HAS_LIBEGL
	select BR2_PACKAGE_HAS_LIBGLES
	select BR2_PACKAGE_HAS_LIBGBM
	select BR2_PACKAGE_LIBGBM_HAS_FEATURE_DMA_BUF
	select BR2_PACKAGE_LIBDRM
	help
	  ARM's proprietary user-space driver for the Mali-400 MP2 in the
	  RK3126C, GBM flavour, as mirrored by Rockchip. The stock 4.4
	  kernel already carries the matching mali-utgard kernel driver
	  and exposes it as /dev/mali; this is only the user-space half.

	  Buildroot's own rockchip-mali package installs the Bifrost G31
	  blob and cannot be pointed at another GPU, which is why this
	  package exists.

if BR2_PACKAGE_MALI_UTGARD

config BR2_PACKAGE_PROVIDES_LIBEGL
	default "mali-utgard"

config BR2_PACKAGE_PROVIDES_LIBGLES
	default "mali-utgard"

config BR2_PACKAGE_PROVIDES_LIBGBM
	default "mali-utgard"

endif

comment "mali-utgard needs a glibc armhf toolchain w/ threads"
	depends on !BR2_ARM_EABIHF || !BR2_TOOLCHAIN_USES_GLIBC || \
		!BR2_TOOLCHAIN_HAS_THREADS
```

## br2-external/package/particles/Config.in
```kconfig
config BR2_PACKAGE_PARTICLES
	bool "particles"
	select BR2_PACKAGE_LIBDRM
	help
	  A particle field drawn straight to a DRM dumb buffer on the
	  TAQ-102 panel, with the touchscreen as an attractor. One process
	  owning KMS: no X, no Wayland, no compositor.
```

## br2-external/package/reboot-loader/Config.in
```kconfig
config BR2_PACKAGE_REBOOT_LOADER
	bool "reboot-loader"
	help
	  Reboot into Rockchip loader mode from our own system, so a
	  reflash does not have to go through Android — which is the one
	  thing that restores the stock recovery partition behind our back.
```

## br2-external/package/rescue-screen/Config.in
```kconfig
config BR2_PACKAGE_RESCUE_SCREEN
	bool "rescue-screen (the rescue image's amber status screen)"
	select BR2_PACKAGE_LIBDRM
	help
	  Draws RESCUE MODE, the kernel, the build id and the Wi-Fi address on
	  the panel through a DRM dumb buffer, so a rescue boot cannot be
	  mistaken for an appliance that failed to draw. taq102-app starts it
	  whenever autostart is off.
```

## br2-external/package/taq102-cube/Config.in
```kconfig
config BR2_PACKAGE_TAQ102_CUBE
	bool "taq102-cube (mainline display and GPU module loader)"
	help
	  The script inittab runs on the mainline image: loads the LVDS PHY,
	  waits for the DRM device, loads gpu-sched and lima, then hands over
	  to taq102-app. The modules themselves come out of the kernel build
	  (kernel/mainline/) and are not packaged here yet; see TODO.md.
```

## br2-external/package/taq102-diag/Config.in
```kconfig
config BR2_PACKAGE_TAQ102_DIAG
	bool "taq102-diag (display and LVDS link diagnostics)"
	select BR2_PACKAGE_LIBDRM
	help
	  The three tools that found the panel's shimmer, kept in the image so
	  the next one does not have to be rebuilt and copied in by hand.

	  testpattern paints one dumb buffer and holds it: single-pixel lines,
	  a checkerboard, flat fields. No GPU and no page flips, so anything
	  that moves on screen is the display path rather than an application.

	  lvdsdiag does a clean modeset and then applies one named PHY variant
	  over /dev/mem, which is how the vendor's PLL dividers were compared
	  against ours. phytune walks the PHY's sampling phase with the current
	  setting shown as large blocks, legible even when the link is failing.
```

## br2-external/package/taq102-display/Config.in
```kconfig
config BR2_PACKAGE_TAQ102_DISPLAY
	bool "taq102-display (LVDS video PHY module and its loader)"
	help
	  The rockchip-inno video combo PHY driver built as a module from our
	  4.4.167 tree, plus the script /init runs to load it before anything
	  draws. Built into the kernel the driver hangs the boot at the PHY's
	  first power-on, before any console exists; loaded after /init has a
	  console it brings the display up in a second.
```

## br2-external/package/taq102-fonts/Config.in
```kconfig
config BR2_PACKAGE_TAQ102_FONTS
	bool "taq102-fonts (Inter, for every text the appliance draws)"
	help
	  Inter Regular and SemiBold (SIL Open Font License 1.1), the one
	  typeface glcube, the control centre and the rescue screen render
	  through stb_truetype. Installed under /usr/share/fonts/taq102/.
```

## br2-external/package/taq102-ssh/Config.in
```kconfig
config BR2_PACKAGE_TAQ102_SSH
	bool "taq102-ssh (dropbear, keyed to /data)"
	select BR2_PACKAGE_DROPBEAR
	help
	  Start dropbear with its host keys and its authorized_keys on
	  /data, so the identity of the machine survives a reflash and a
	  serial cable stops being the only way in.

	  Password authentication is off: root has no password here, and
	  giving one to a device on the LAN is worse than requiring a key.
```

## br2-external/package/taq102-wifi/Config.in
```kconfig
config BR2_PACKAGE_TAQ102_WIFI
	bool "taq102-wifi (RTL8723CS driver and bring-up)"
	select BR2_PACKAGE_WPA_SUPPLICANT
	select BR2_PACKAGE_WPA_SUPPLICANT_NL80211
	select BR2_PACKAGE_WPA_SUPPLICANT_CLI
	select BR2_PACKAGE_WPA_SUPPLICANT_PASSPHRASE
	help
	  The stock RTL8723CS module taken off this device, plus the script
	  that loads it and brings wlan0 up from a configuration on /data.

	  The module is the vendor's own binary rather than a rebuild: the
	  stock kernel is built with CONFIG_MODVERSIONS=y, so any rebuilt
	  kernel would have to reproduce both the vermagic string and every
	  symbol CRC before it would load.
```
